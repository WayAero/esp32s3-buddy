## components/esp_desktop_buddy/Kconfig
```kconfig
menu "ESP Desktop Buddy Core"

config ESP_DESKTOP_BUDDY_LINE_MAX
    int "Max JSON line length"
    range 256 4096
    default 4096
    help
        Maximum inbound or outbound UTF-8 JSON payload bytes before the trailing newline.

config ESP_DESKTOP_BUDDY_FEED_RX_CHUNK_MAX
    int "Max bytes per esp_desktop_buddy_receive_bytes() call"
    range 16 1024
    default 512
    help
        Maximum number of bytes accepted by a single esp_desktop_buddy_receive_bytes() call.
        This currently also sizes each RX item stored in the core inbox queue,
        so calls larger than this are rejected before any bytes are accepted.
        This is an internal core buffering limit, not a transport tuning knob.

config ESP_DESKTOP_BUDDY_RX_INBOX_DEPTH
    int "RX inbox depth"
    range 2 32
    default 16
    help
        Number of pending RX byte chunks that can wait in the core inbox before
        the worker task processes them. Increase this if your transport can burst
        multiple packets faster than the core task drains them.

config ESP_DESKTOP_BUDDY_ACTION_QUEUE_DEPTH
    int "Action inbox depth"
    range 2 32
    default 8
    help
        Number of locally posted actions, such as prompt replies, that can wait
        in the core inbox alongside RX work before being processed.

config ESP_DESKTOP_BUDDY_TX_QUEUE_DEPTH
    int "TX queue depth"
    range 2 32
    default 8
    help
        Number of encoded outbound frames that can be buffered for the active
        transport before backpressure is reported to the caller.

config ESP_DESKTOP_BUDDY_LIVE_TIMEOUT_MS
    int "State live timeout (ms)"
    range 1000 120000
    default 30000
    help
        Milliseconds after the most recent accepted state push before the core marks
        the session as not live and rejects stale prompt responses.

config ESP_DESKTOP_BUDDY_ENTRY_COUNT_MAX
    int "Mirrored entry count limit"
    range 1 32
    default 8
    help
        Maximum number of state entry strings mirrored inside the Buddy core.
        This internal storage limit also bounds what esp_desktop_buddy_get_entry_count() and
        esp_desktop_buddy_get_entry() can return to callers.

config ESP_DESKTOP_BUDDY_ENTRY_STRING_MAX
    int "Mirrored entry string limit"
    range 16 256
    default 92
    help
        Maximum UTF-8 bytes stored for each mirrored state entry string, not
        including the trailing NUL terminator kept in internal core storage.

config ESP_DESKTOP_BUDDY_MESSAGE_MAX
    int "Mirrored message string limit"
    range 16 256
    default 96
    help
        Maximum UTF-8 bytes stored for the mirrored state message string, not
        including the trailing NUL terminator kept in internal core storage.

config ESP_DESKTOP_BUDDY_PROMPT_ID_MAX
    int "Prompt id string limit"
    range 8 128
    default 40
    help
        Maximum UTF-8 bytes stored for the active prompt identifier in the core's
        mirrored state. esp_desktop_buddy_get_prompt_id() and prompt-response events reflect
        this stored value.

config ESP_DESKTOP_BUDDY_PROMPT_TOOL_MAX
    int "Prompt tool string limit"
    range 8 64
    default 20
    help
        Maximum UTF-8 bytes stored for the active prompt tool string in the
        core's mirrored state.

config ESP_DESKTOP_BUDDY_PROMPT_HINT_MAX
    int "Prompt hint string limit"
    range 8 1024
    default 1024
    help
        Maximum UTF-8 bytes stored for the active prompt hint string in the
        core's mirrored state.

config ESP_DESKTOP_BUDDY_PROTOCOL_TRACE
    bool "Log raw Buddy protocol frames"
    default n
    help
        Log inbound and outbound Buddy JSON lines at the core protocol
        boundary. This is intended for transport and protocol debugging and
        can expose user-visible content such as prompts, names, and state
        text, so it is disabled by default.

config ESP_DESKTOP_BUDDY_LOG_PREVIEW_LEN
    int "Log preview length"
    range 32 512
    default 240
    help
        Maximum number of payload bytes copied into malformed-input logs and
        protocol trace previews.

endmenu
```

## components/esp_desktop_buddy_folder_push/Kconfig
```kconfig
menu "ESP Desktop Buddy Folder Push"

config ESP_DESKTOP_BUDDY_FOLDER_PUSH_MAX_RAW_CHUNK
    int "Max base64 chunk length"
    range 64 4096
    default 1024
    help
        Maximum base64-encoded chunk bytes accepted by a single `chunk`
        command before the folder-push state machine rejects the request.

config ESP_DESKTOP_BUDDY_FOLDER_PUSH_MAX_DECODED_CHUNK
    int "Max decoded chunk length"
    range 64 4096
    default 512
    help
        Maximum decoded payload bytes accepted from a single `chunk`
        command before the state machine rejects the request prior to
        sink writeout.

        The implementation allocates a decode buffer of this size on the Buddy
        core task stack while handling a `chunk` command. Keep this value small
        enough to fit within the core task's stack budget.

config ESP_DESKTOP_BUDDY_FOLDER_PUSH_MAX_TRANSFER_BYTES
    int "Max transfer size bytes"
    range 0 4194304
    default 1800000
    help
        Maximum total decoded payload bytes accepted by a single `char_begin`
        transfer. Set this to zero to disable the limit. Transfers that exceed
        the configured cap are rejected before any sink callbacks run.

config ESP_DESKTOP_BUDDY_FOLDER_PUSH_MAX_FILE_BYTES
    int "Max single file size bytes"
    range 0 1048576
    default 229376
    help
        Maximum decoded payload bytes accepted for one `file` command. Set this
        to zero to disable the per-file limit. Oversized files abort the active
        transfer before the sink creates or writes the file.

config ESP_DESKTOP_BUDDY_FOLDER_PUSH_FLAT_PATHS_ONLY
    bool "Restrict paths to flat relative filenames"
    default y
    help
        Reject paths containing `/` so the folder-push state machine accepts
        only flat relative filenames. Disable this if your sink intentionally
        supports nested directory staging.

endmenu
```

## components/lvgl_runtime_patch/Kconfig
```kconfig
menu "Buddy LVGL runtime"

config BUDDY_LVGL_CORE
    int "LVGL worker, swdraw and UI core"
    range 0 1
    default 0 if FREERTOS_UNICORE
    default 1
    help
        CPU affinity shared by the LVGL adapter worker, LVGL software draw
        threads and the Buddy UI task. ESP32-S3 uses CPU1 by default.

config BUDDY_DYNAMIC_ZH_FONT
    bool "Load dynamic Chinese binfont"
    default y
    help
        Load S:fonts/zh_cn_14.bin as the fallback font for Chinese. Disable
        only to isolate a rendering failure; built-in Chinese fonts remain.

endmenu
```

## sdkconfig.defaults
```kconfig
CONFIG_BT_ENABLED=y
CONFIG_BT_NIMBLE_ENABLED=y
CONFIG_BT_NIMBLE_ROLE_CENTRAL=n
CONFIG_BT_NIMBLE_ROLE_OBSERVER=n
CONFIG_BT_NIMBLE_ROLE_BROADCASTER=y
CONFIG_BT_NIMBLE_ROLE_PERIPHERAL=y
CONFIG_BT_NIMBLE_MAX_CONNECTIONS=1
CONFIG_BT_NIMBLE_MEM_ALLOC_MODE_EXTERNAL=y
CONFIG_BT_NIMBLE_LOG_LEVEL_WARNING=y
CONFIG_LOG_DEFAULT_LEVEL_INFO=y
CONFIG_IDF_TARGET="esp32s3"
CONFIG_ESPTOOLPY_FLASHSIZE_16MB=y
CONFIG_ESPTOOLPY_FLASHMODE_DIO=y
CONFIG_ESP_DEFAULT_CPU_FREQ_MHZ_240=y
CONFIG_PM_ENABLE=y
CONFIG_ESP32S3_DATA_CACHE_LINE_64B=y
CONFIG_FREERTOS_HZ=1000
CONFIG_FREERTOS_USE_TRACE_FACILITY=y
CONFIG_FREERTOS_USE_STATS_FORMATTING_FUNCTIONS=y
CONFIG_FREERTOS_GENERATE_RUN_TIME_STATS=y
CONFIG_FREERTOS_RUN_TIME_STATS_USING_ESP_TIMER=y
CONFIG_ESP_CONSOLE_UART_DEFAULT=y
CONFIG_SPIRAM=y
CONFIG_SPIRAM_MODE_OCT=y
CONFIG_SPIRAM_FETCH_INSTRUCTIONS=y
CONFIG_SPIRAM_RODATA=y
CONFIG_SPIRAM_SPEED_80M=y
CONFIG_SPIRAM_ALLOW_BSS_SEG_EXTERNAL_MEMORY=y
CONFIG_LV_CONF_SKIP=y
CONFIG_LV_BUILD_EXAMPLES=n
CONFIG_LV_OS_FREERTOS=y
# CONFIG_LV_USE_CLIB_MALLOC is not set
CONFIG_LV_USE_CLIB_SPRINTF=y
CONFIG_LV_USE_CLIB_STRING=y
CONFIG_LV_USE_FLOAT=y
CONFIG_LV_USE_GESTURE_RECOGNITION=y
CONFIG_LV_USE_FONT_COMPRESSED=y
CONFIG_LV_FONT_MONTSERRAT_12=y
CONFIG_LV_FONT_MONTSERRAT_16=y
CONFIG_LV_FONT_MONTSERRAT_20=y
CONFIG_LV_FONT_MONTSERRAT_24=y
CONFIG_LV_FONT_MONTSERRAT_40=y
CONFIG_PARTITION_TABLE_CUSTOM=y
CONFIG_PARTITION_TABLE_CUSTOM_FILENAME="partitions.csv"
CONFIG_LV_USE_FS_STDIO=y
CONFIG_LV_FS_STDIO_LETTER=83
CONFIG_LV_FS_STDIO_PATH="/spiffs/"
CONFIG_LV_USE_FS_MEMFS=y
CONFIG_LV_FS_MEMFS_LETTER=77
CONFIG_LV_USE_GIF=y
CONFIG_LV_DRAW_SW_SUPPORT_ARGB8888=y
CONFIG_BUDDY_DYNAMIC_ZH_FONT=y
CONFIG_XPT2046_Z_THRESHOLD=400
CONFIG_XPT2046_INTERRUPT_MODE=y
# CONFIG_XPT2046_CONVERT_ADC_TO_COORDS is not set
CONFIG_LV_USE_SYSMON=y
CONFIG_LV_USE_PERF_MONITOR=y
CONFIG_LV_PERF_MONITOR_ALIGN_BOTTOM_RIGHT=y
CONFIG_LV_DEF_REFR_PERIOD=33
CONFIG_ESP_DESKTOP_BUDDY_RX_INBOX_DEPTH=16
CONFIG_ESP_DESKTOP_BUDDY_PROMPT_HINT_MAX=1024
CONFIG_ESP_DESKTOP_BUDDY_FOLDER_PUSH_MAX_FILE_BYTES=1048576
CONFIG_ESP_DESKTOP_BUDDY_FOLDER_PUSH_MAX_TRANSFER_BYTES=4194304

CONFIG_LV_USE_CUSTOM_MALLOC=y
```
